## drivers/input/touchscreen/adaptive-ts/vendors/Kconfig
```kconfig
#
# Controller definitions for adaptive touchscreen
#

config TOUCHSCREEN_ADAPTIVE_VENDOR_FOCALTECH
    bool "Focaltech controller definition for adaptive touchscreen"
    depends on I2C || TOUCHSCREEN_ADAPTIVE
    help
      Say Y here if you have a focaltech based touchscreen controller.

      If unsure, say N.

config TOUCHSCREEN_ADAPTIVE_VENDOR_MSTAR
    bool "MStar controller definition for adaptive touchscreen"
    depends on I2C || TOUCHSCREEN_ADAPTIVE
    help
      Say Y here if you have a mstar based touchscreen controller.

      If unsure, say N.
```

## drivers/nfc/st21nfc/Kconfig
```kconfig
config NFC_ST21NFC
  tristate "ST Microelectronics ST21NFC NFC Controller Driver"
  default y
  ---help---
      ST Microelectronics ST21NFC Near Field Communication controller
```

## drivers/soc/sprd/usbpinmux/Kconfig
```kconfig
config SPRD_USBPINMUX
	bool "Spreadtrum USBPINMUX Support"
        default n
	help
	  Say Y here to support QOGIRL6 USBPINMUX.
```
